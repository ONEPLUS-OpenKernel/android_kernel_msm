## drivers/oneplus/Kconfig
```kconfig
menuconfig ONEPLUS
	bool "ONEPLUS device specific drivers"
	default n

if ONEPLUS

source "drivers/oneplus/kernel/Kconfig"
source "drivers/oneplus/misc/Kconfig"
source "drivers/oneplus/power/Kconfig"

endif # ONEPLUS
```

## drivers/oneplus/power/supply/Kconfig
```kconfig
# oem device driver for charge
#
source "drivers/oneplus/power/supply/qcom/Kconfig"
```
